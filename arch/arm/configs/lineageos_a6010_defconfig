## drivers/media/platform/msm/Kconfig
```kconfig
source "drivers/media/platform/msm/vidc/Kconfig"

#
# MSM camera configuration
#

comment "QTI MSM Camera And Video & AIS"

menuconfig MSM_CAMERA
	bool "QTI MSM camera and video capture support"
	depends on ARCH_MSM && VIDEO_V4L2 && I2C
	---help---
	  Say Y here to enable selecting the video adapters for
	  QTI msm camera and video capture drivers. enabling this
	  adds support for the camera driver stack including sensor, isp
	  and postprocessing drivers for legacy chipsets.

config MSM_CAMERA_DEBUG
	bool "QTI MSM camera debugging with printk"
	depends on MSM_CAMERA
	default n
	---help---
	  Enable printk() debug for msm camera

config MSM_CAMERA_AUTOMOTIVE
	bool "QTI MSM camera for automotive support"
	depends on MSM_CAMERA
	default n
	---help---
	  Enables support for automotive targets

menuconfig MSMB_CAMERA
	bool "QTI MSM camera and video capture 2.0 support"
	depends on ARCH_MSM && VIDEO_V4L2 && I2C
	---help---
	  Say Y here to enable selecting the video adapters for
	  QTI msm camera and video capture 2.0, enabling this
	  adds support for the camera driver stack including sensor, isp
	  and postprocessing drivers.

config MSMB_CAMERA_DEBUG
	bool "QTI MSM camera 2.0 debugging with printk"
	depends on MSMB_CAMERA
	---help---
	  Enable printk() debug for msm camera 2.0

choice
	prompt "Qualcomm Camera stack variant"
	depends on MSMB_CAMERA
	default MSMB_CAMERA_DEFAULT

config MSMB_CAMERA_DEFAULT
	bool "Default"

config MSMB_CAMERA_SAMSUNG
	bool "Samsung"
	depends on MACH_SAMSUNG

endchoice

if MSMB_CAMERA_DEFAULT
source "drivers/media/platform/msm/camera_v2/Kconfig"
endif # MSMB_CAMERA_DEFAULT

if MSMB_CAMERA_SAMSUNG
source "drivers/media/platform/msm/sec_camera_v2/Kconfig"
endif # MSMB_CAMERA_SAMSUNG

source "drivers/media/platform/msm/dvb/Kconfig"
source "drivers/media/platform/msm/broadcast/Kconfig"
source "drivers/media/platform/msm/sde/Kconfig"
```
